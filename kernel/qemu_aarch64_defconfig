## tools/build/claude_os_defconfig
```kconfig
# Claude-OS Buildroot defconfig
# Target: ARM64 (aarch64) QEMU virt machine

# Architecture
BR2_aarch64=y

# Toolchain
BR2_TOOLCHAIN_BUILDROOT_GLIBC=y
BR2_KERNEL_HEADERS_6_6=y
BR2_TOOLCHAIN_BUILDROOT_CXX=y

# Kernel
BR2_LINUX_KERNEL=y
BR2_LINUX_KERNEL_CUSTOM_VERSION=y
BR2_LINUX_KERNEL_CUSTOM_VERSION_VALUE="6.6.20"
BR2_LINUX_KERNEL_USE_CUSTOM_CONFIG=y
BR2_LINUX_KERNEL_CUSTOM_CONFIG_FILE="$(BR2_EXTERNAL_CLAUDEOS_PATH)/kernel/qemu_aarch64_defconfig"
BR2_LINUX_KERNEL_IMAGE_TARGET_CUSTOM=y
BR2_LINUX_KERNEL_IMAGE_TARGET_NAME="Image"
BR2_LINUX_KERNEL_NEEDS_HOST_OPENSSL=y

# Filesystem
BR2_TARGET_ROOTFS_EXT2=y
BR2_TARGET_ROOTFS_EXT2_4=y
BR2_TARGET_ROOTFS_EXT2_SIZE="512M"

# Init system
BR2_INIT_SYSTEMD=y

# System configuration
BR2_TARGET_GENERIC_HOSTNAME="claude-os"
BR2_TARGET_GENERIC_ISSUE="Welcome to Claude-OS"
BR2_SYSTEM_DHCP="eth0"
BR2_TARGET_GENERIC_ROOT_PASSWD="claude"

# Networking - WiFi support
BR2_PACKAGE_WPA_SUPPLICANT=y
BR2_PACKAGE_WPA_SUPPLICANT_NL80211=y
BR2_PACKAGE_WPA_SUPPLICANT_AUTOSCAN=y
BR2_PACKAGE_WPA_SUPPLICANT_CLI=y
BR2_PACKAGE_IW=y
BR2_PACKAGE_WIRELESS_TOOLS=y
BR2_PACKAGE_DHCPCD=y
BR2_PACKAGE_IPTABLES=y
BR2_PACKAGE_IPROUTE2=y

# Useful base packages
BR2_PACKAGE_BASH=y
BR2_PACKAGE_NANO=y
BR2_PACKAGE_HTOP=y
BR2_PACKAGE_CURL=y
BR2_PACKAGE_CA_CERTIFICATES=y
BR2_PACKAGE_OPENSSL=y
BR2_PACKAGE_DBUS=y
BR2_PACKAGE_UTIL_LINUX=y
BR2_PACKAGE_UTIL_LINUX_HWCLOCK=y

# Python (for system scripts and prototyping)
BR2_PACKAGE_PYTHON3=y
BR2_PACKAGE_PYTHON3_SSL=y

# Firmware for QEMU virtual WiFi
BR2_PACKAGE_LINUX_FIRMWARE=y
```

## tools/build/kernel/qemu_aarch64_defconfig
```kconfig
# Linux kernel config for QEMU aarch64 virt machine
# Based on defconfig with QEMU-specific options

CONFIG_SYSVIPC=y
CONFIG_POSIX_MQUEUE=y
CONFIG_NO_HZ_IDLE=y
CONFIG_HIGH_RES_TIMERS=y
CONFIG_PREEMPT=y
CONFIG_BSD_PROCESS_ACCT=y
CONFIG_TASKSTATS=y
CONFIG_TASK_XACCT=y
CONFIG_TASK_IO_ACCOUNTING=y
CONFIG_IKCONFIG=y
CONFIG_IKCONFIG_PROC=y
CONFIG_MEMCG=y
CONFIG_BLK_CGROUP=y
CONFIG_CGROUP_SCHED=y
CONFIG_CFS_BANDWIDTH=y
CONFIG_CGROUP_PIDS=y
CONFIG_CGROUP_FREEZER=y
CONFIG_CGROUP_DEVICE=y
CONFIG_CGROUP_CPUACCT=y
CONFIG_NAMESPACES=y
CONFIG_USER_NS=y
CONFIG_BLK_DEV_INITRD=y

# Architecture
CONFIG_ARCH_VIRT=y
CONFIG_SMP=y
CONFIG_NR_CPUS=8

# Platform - QEMU virt
CONFIG_PCI=y
CONFIG_PCI_HOST_GENERIC=y

# Networking
CONFIG_NET=y
CONFIG_PACKET=y
CONFIG_UNIX=y
CONFIG_INET=y
CONFIG_IP_MULTICAST=y
CONFIG_IP_PNP=y
CONFIG_IP_PNP_DHCP=y
CONFIG_IPV6=y
CONFIG_NETFILTER=y
CONFIG_NF_CONNTRACK=y
CONFIG_NF_TABLES=y
CONFIG_NF_TABLES_INET=y
CONFIG_NFT_CT=y
CONFIG_NFT_NAT=y
CONFIG_NF_NAT=y
CONFIG_BRIDGE=m

# Wireless (for virtual WiFi support)
CONFIG_CFG80211=y
CONFIG_MAC80211=y
CONFIG_MAC80211_LEDS=y

# Block devices
CONFIG_BLK_DEV=y
CONFIG_VIRTIO_BLK=y

# SCSI
CONFIG_SCSI=y
CONFIG_BLK_DEV_SD=y
CONFIG_SCSI_VIRTIO=y

# Network device support
CONFIG_NETDEVICES=y
CONFIG_VIRTIO_NET=y
CONFIG_VETH=y

# Input
CONFIG_INPUT_EVDEV=y

# Serial / Console
CONFIG_SERIAL_AMBA_PL011=y
CONFIG_SERIAL_AMBA_PL011_CONSOLE=y

# Virtio
CONFIG_VIRTIO_PCI=y
CONFIG_VIRTIO_BALLOON=y
CONFIG_VIRTIO_INPUT=y
CONFIG_VIRTIO_MMIO=y

# GPIO
CONFIG_GPIOLIB=y

# RTC
CONFIG_RTC_CLASS=y
CONFIG_RTC_DRV_PL031=y

# Filesystem
CONFIG_EXT4_FS=y
CONFIG_EXT4_FS_POSIX_ACL=y
CONFIG_TMPFS=y
CONFIG_TMPFS_POSIX_ACL=y
CONFIG_PROC_FS=y
CONFIG_SYSFS=y
CONFIG_DEVTMPFS=y
CONFIG_DEVTMPFS_MOUNT=y
CONFIG_VFAT_FS=y
CONFIG_9P_FS=y
CONFIG_9P_FS_POSIX_ACL=y

# 9P transport (for host directory sharing)
CONFIG_NET_9P=y
CONFIG_NET_9P_VIRTIO=y

# DRM/Display (for future GUI)
CONFIG_DRM=y
CONFIG_DRM_VIRTIO_GPU=y

# Sound (virtio)
CONFIG_SOUND=y
CONFIG_SND=y
CONFIG_SND_VIRTIO=y

# Random number generator
CONFIG_HW_RANDOM=y
CONFIG_HW_RANDOM_VIRTIO=y

# Crypto
CONFIG_CRYPTO_AES=y
CONFIG_CRYPTO_SHA256=y

# Printk / Debug
CONFIG_PRINTK=y
CONFIG_EARLY_PRINTK=y
```
